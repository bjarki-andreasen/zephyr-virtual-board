## dts/bindings/zvb_bus/zvb,zvb-bus.yaml
```yaml
# Copyright (c) 2025 Nordic Semiconductor ASA
# SPDX-License-Identifier: Apache-2.0

description: |
  Zephyr Virtual Board Bus Controller

  Transport interface between zephyr host and
  Zephyr Virtual Board compatible device

  Example:

    zvb {
            compatible = "zvb,zvb-bus";

            dev0@0 {
                    reg = <0>;
                    ...
            };

            dev0@1 {
                    reg = <1>;
                    ...
            };
    };

compatible: zvb,zvb-bus

include: zvb-bus-controller.yaml
```

## dts/bindings/zvb_bus/zvb-bus-controller.yaml
```yaml
# Copyright (c) 2025 Nordic Semiconductor ASA
# SPDX-License-Identifier: Apache-2.0

description: |
  Zephyr Virtual Board bus controller

  Transport interface between zephyr host and
  Zephyr Virtual Board compatible device.

include: base.yaml

properties:
  "#address-cells":
    required: true
    const: 1

  "#size-cells":
    required: true
    const: 0

bus: zvb-bus
```

## dts/bindings/zvb_bus/zvb-bus-device.yaml
```yaml
# Copyright (c) 2025 Nordic Semiconductor ASA
# SPDX-License-Identifier: Apache-2.0

description: |
  Zephyr Virtual Board Bus Device

  Transport interface between zephyr host and
  Zephyr Virtual Board compatible device.

include: base.yaml

properties:
  reg:
    required: true
    description: Device address on zvb bus

on-bus: zvb-bus
```

## subsys/Kconfig
```kconfig
# Copyright (c) 2025 Nordic Semiconductor ASA
# SPDX-License-Identifier: Apache-2.0

rsource "control_system/Kconfig"
```

## subsys/control_system/Kconfig
```kconfig
# Copyright (c) 2025 Nordic Semiconductor ASA
# SPDX-License-Identifier: Apache-2.0

config CONTROL_SYSTEM
	bool "Control system support"

if CONTROL_SYSTEM

rsource "control/Kconfig"
rsource "signal/Kconfig"
rsource "transfer/Kconfig"
rsource "Kconfig.shell"

endif # CONTROL_SYSTEM
```

## subsys/control_system/Kconfig.shell
```kconfig
# Copyright (c) 2025 Nordic Semiconductor ASA
# SPDX-License-Identifier: Apache-2.0

config CONTROL_SYSTEM_SHELL
	bool "Control system shell commands"
	default y if SHELL
```

## subsys/control_system/control/Kconfig
```kconfig
# Copyright (c) 2025 Nordic Semiconductor ASA
# SPDX-License-Identifier: Apache-2.0

config CONTROL_SYSTEM_CONTROL
	bool "Control system control support"

if CONTROL_SYSTEM_CONTROL

rsource "Kconfig.pid"

endif # CONTROL_SYSTEM_CONTROL
```

## subsys/control_system/control/Kconfig.pid
```kconfig
# Copyright (c) 2025 Nordic Semiconductor ASA
# SPDX-License-Identifier: Apache-2.0

config CONTROL_SYSTEM_CONTROL_PID
	bool "PID control system control support"
	depends on DSP
```

## subsys/control_system/osignal/Kconfig
```kconfig
# Copyright (c) 2025 Nordic Semiconductor ASA
# SPDX-License-Identifier: Apache-2.0

config CONTROL_SYSTEM_OSIGNAL
	bool "Control system output signal support"

if CONTROL_SYSTEM_OSIGNAL

rsource "Kconfig.pwm"

endif # CONTROL_SYSTEM_OSIGNAL
```

## subsys/control_system/osignal/Kconfig.pwm
```kconfig
# Copyright (c) 2025 Nordic Semiconductor ASA
# SPDX-License-Identifier: Apache-2.0

config CONTROL_SYSTEM_OSIGNAL_PWM
	bool "PWM control system output signal support"
	select PWM
```

## subsys/control_system/signal/Kconfig
```kconfig
# Copyright (c) 2025 Nordic Semiconductor ASA
# SPDX-License-Identifier: Apache-2.0

config CONTROL_SYSTEM_SIGNAL
	bool "Control system signal support"
```

## subsys/control_system/transfer/Kconfig
```kconfig
# Copyright (c) 2025 Nordic Semiconductor ASA
# SPDX-License-Identifier: Apache-2.0

config CONTROL_SYSTEM_TRANSFER
	bool "Control system transfer function support"

if CONTROL_SYSTEM_TRANSFER

rsource "Kconfig.differential"
rsource "Kconfig.integral"
rsource "Kconfig.normal"

endif # CONTROL_SYSTEM_TRANSFER
```

## subsys/control_system/transfer/Kconfig.differential
```kconfig
# Copyright (c) 2025 Nordic Semiconductor ASA
# SPDX-License-Identifier: Apache-2.0

config CONTROL_SYSTEM_TRANSFER_DIFFERENTIAL
	bool "Differential control system transfer function support"
```

## subsys/control_system/transfer/Kconfig.integral
```kconfig
# Copyright (c) 2025 Nordic Semiconductor ASA
# SPDX-License-Identifier: Apache-2.0

config CONTROL_SYSTEM_TRANSFER_INTEGRAL
	bool "Integral control system transfer function support"
```

## subsys/control_system/transfer/Kconfig.linear
```kconfig
# Copyright (c) 2025 Nordic Semiconductor ASA
# SPDX-License-Identifier: Apache-2.0

config CONTROL_SYSTEM_TRANSFER_LINEAR
	bool "Linear control system transfer function support"
```

## west.yml
```yaml
# Copyright (c) 2025 Nordic Semiconductor ASA
# SPDX-License-Identifier: Apache-2.0

manifest:
  remotes:
    - name: upstream
      url-base: https://github.com/zephyrproject-rtos

  projects:
    - name: zephyr
      remote: upstream
      revision: v4.2.0
      import: true

  self:
    path: zvb
```
