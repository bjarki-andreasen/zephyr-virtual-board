## Kconfig
```kconfig
# Copyright (c) 2025 Nordic Semiconductor ASA
# SPDX-License-Identifier: Apache-2.0

rsource "drivers/Kconfig"
rsource "subsys/Kconfig"
```

## boards/native/mug_wheel/native_sim_mug_wheel_defconfig
```kconfig
# Copyright (c) 2025 Nordic Semiconductor ASA
# SPDX-License-Identifier: Apache-2.0

CONFIG_CONSOLE=y
CONFIG_SYS_CLOCK_HW_CYCLES_PER_SEC=1000000
CONFIG_NATIVE_SIM_SLOWDOWN_TO_REAL_TIME=y

# This should technically be in a snippet,
# but it is pretty essential to this board
# working, so we place it here for
# convenience.
CONFIG_NET_NATIVE_OFFLOADED_SOCKETS=y
CONFIG_NET_SOCKETS_OFFLOAD=y
CONFIG_NET_DRIVERS=y
CONFIG_ETH_DRIVER=n
CONFIG_HEAP_MEM_POOL_SIZE=8192
CONFIG_NETWORKING=y
CONFIG_NET_IPV4=y
CONFIG_NET_UDP=y
CONFIG_NET_SOCKETS=y
```

## boards/nordic/nrf54l15dk/board.yml
```yaml
# Copyright (c) 2025 Nordic Semiconductor ASA
# SPDX-License-Identifier: Apache-2.0

board:
  extend: nrf54l15dk
  variants:
    - name: mug_wheel
      qualifier: nrf54l15/cpuapp
```

## boards/nordic/nrf54l15dk/nrf54l15dk_nrf54l15_cpuapp_mug_wheel_defconfig
```kconfig
# Copyright (c) 2024 Nordic Semiconductor ASA
# SPDX-License-Identifier: Apache-2.0

# Enable UART driver
CONFIG_SERIAL=y

# Enable console
CONFIG_CONSOLE=y
CONFIG_UART_CONSOLE=y

# Enable GPIO
CONFIG_GPIO=y

# Enable MPU
CONFIG_ARM_MPU=y

# BMI160
CONFIG_SENSOR=y
CONFIG_BMI160_TRIGGER_NONE=y
CONFIG_BMI160_ACCEL_PMU_NORMAL=y
CONFIG_BMI160_ACCEL_RANGE_4G=y
CONFIG_BMI160_ACCEL_ODR_400=y
CONFIG_BMI160_GYRO_PMU_NORMAL=y
CONFIG_BMI160_GYRO_RANGE_500DPS=y
CONFIG_BMI160_GYRO_ODR_200=y

# Servo and motor
CONFIG_ACTUATOR=y
CONFIG_DSP=y
CONFIG_CMSIS_DSP=y
CONFIG_CMSIS_DSP_BASICMATH=y
CONFIG_DSP_BACKEND_CMSIS=y
```

## drivers/Kconfig
```kconfig
# Copyright (c) 2025 Nordic Semiconductor ASA
# SPDX-License-Identifier: Apache-2.0

rsource "actuator/Kconfig"
rsource "input/Kconfig"
rsource "led/Kconfig"
rsource "sensor/Kconfig"
rsource "zvb_bus/Kconfig"
```

## drivers/actuator/Kconfig
```kconfig
# Copyright (c) 2025 Nordic Semiconductor ASA
# SPDX-License-Identifier: Apache-2.0

config ACTUATOR
	bool "Actuator device driver support"

if ACTUATOR

rsource "Kconfig.servo_pwm"
rsource "Kconfig.zvb"

endif # ACTUATOR
```

## drivers/actuator/Kconfig.dri0042
```kconfig
# Copyright (c) 2025 Nordic Semiconductor ASA
# SPDX-License-Identifier: Apache-2.0

config ACTUATOR_DRI0042
	bool "DFRobot DRI0042 device driver"
	default y
	depends on DT_HAS_DFROBOT_DRI0042_ENABLED
	select PWM
	select GPIO
	select CONTROL_SYSTEM
	select CONTROL_SYSTEM_SIGNAL
```

## drivers/actuator/Kconfig.shell
```kconfig
# Copyright (c) 2025 Nordic Semiconductor ASA
# SPDX-License-Identifier: Apache-2.0

config ACTUATOR_SHELL
	bool "PWM driven servo device driver"
	depends on SHELL
```

## drivers/actuator/Kconfig.zvb
```kconfig
# Copyright (c) 2025 Nordic Semiconductor ASA
# SPDX-License-Identifier: Apache-2.0

config ACTUATOR_ZVB
	bool "ZVB Zephyr Virtual actuator device driver"
	default y
	depends on DT_HAS_ZVB_ACTUATOR_ENABLED
	select ZVB_BUS
```

## drivers/input/Kconfig
```kconfig
# Copyright (c) 2025 Nordic Semiconductor ASA
# SPDX-License-Identifier: Apache-2.0

if INPUT

rsource "Kconfig.zvb_button"

endif # INPUT
```

## drivers/input/Kconfig.zvb_button
```kconfig
# Copyright (c) 2025 Nordic Semiconductor ASA
# SPDX-License-Identifier: Apache-2.0

config INPUT_ZVB_BUTTON
	bool "ZVB Zephyr Virtual button input device driver"
	default y
	depends on DT_HAS_ZVB_BUTTON_ENABLED
	select ZVB_BUS
```

## drivers/led/Kconfig
```kconfig
# Copyright (c) 2025 Nordic Semiconductor ASA
# SPDX-License-Identifier: Apache-2.0

if LED

rsource "Kconfig.zvb"

endif # LED
```

## drivers/led/Kconfig.zvb
```kconfig
# Copyright (c) 2025 Nordic Semiconductor ASA
# SPDX-License-Identifier: Apache-2.0

config LED_ZVB
	bool "ZVB Zephyr Virtual LED device driver"
	default y
	depends on DT_HAS_ZVB_LED_ENABLED
	select ZVB_BUS
```

## drivers/sensor/Kconfig
```kconfig
# Copyright (c) 2025 Nordic Semiconductor ASA
# SPDX-License-Identifier: Apache-2.0

if SENSOR

rsource "Kconfig.soft_qdec"
rsource "Kconfig.zvb_imu"
rsource "Kconfig.zvb_sensor"

endif # SENSOR
```

## drivers/sensor/Kconfig.soft_qdec
```kconfig
# Copyright (c) 2025 Nordic Semiconductor ASA
# SPDX-License-Identifier: Apache-2.0

config SENSOR_FLPR_QDEC
	bool "FLPR software QDEC device driver"
	default y
	depends on DT_HAS_FLPR_QDEC_ENABLED
	depends on IPC_SERVICE
	depends on SENSOR_ASYNC_API
```

## drivers/sensor/Kconfig.zvb_imu
```kconfig
# Copyright (c) 2025 Nordic Semiconductor ASA
# SPDX-License-Identifier: Apache-2.0

config SENSOR_ZVB_IMU
	bool "ZVB Zephyr Virtual IMU device driver"
	default y
	depends on DT_HAS_ZVB_IMU_ENABLED
	select ZVB_BUS
	select RTIO
	depends on SENSOR_ASYNC_API
```

## drivers/sensor/Kconfig.zvb_sensor
```kconfig
# Copyright (c) 2025 Nordic Semiconductor ASA
# SPDX-License-Identifier: Apache-2.0

config SENSOR_ZVB_SENSOR
	bool "ZVB Zephyr Virtual sensor device driver"
	default y
	depends on DT_HAS_ZVB_SENSOR_ENABLED
	select ZVB_BUS
	select RTIO
	depends on SENSOR_ASYNC_API

if SENSOR_ZVB_SENSOR

config SENSOR_ZVB_SENSOR_MAX_CHANNELS
	int "Maximum number of channels to include in a reading"
	default 8

endif # SENSOR_ZVB_SENSOR
```

## drivers/zvb_bus/Kconfig
```kconfig
# Copyright (c) 2025 Nordic Semiconductor ASA
# SPDX-License-Identifier: Apache-2.0

config ZVB_BUS
	bool "Zephyr Virtual Board bus"

if ZVB_BUS

module = ZVB_BUS
module-str = zvb_bus
source "subsys/logging/Kconfig.template.log_config"

rsource "Kconfig.zvb"

endif # ZVB_BUS
```

## drivers/zvb_bus/Kconfig.zvb
```kconfig
# Copyright (c) 2025 Nordic Semiconductor ASA
# SPDX-License-Identifier: Apache-2.0

# Copyright (c) 2025 Nordic Semiconductor ASA
# SPDX-License-Identifier: Apache-2.0

config ZVB_BUS_ZVB
	bool "ZVB Zephyr Virtual Bus device driver"
	default y
	depends on DT_HAS_ZVB_ZVB_BUS_ENABLED
	depends on NETWORKING
	depends on NET_IPV4
	depends on NET_UDP
	depends on NET_SOCKETS

if ZVB_BUS_ZVB

config ZVB_BUS_ZVB_PING_INTERVAL_MS
	int "ZVB Zephyr Virtual Bus ping interval"
	default 100

config ZVB_BUS_ZVB_TRANSFER_BUF_SIZE
	int "Transfer buffer size in bytes"
	default 256

config ZVB_BUS_ZVB_HOST_ADDR
	string "ZVB Zephyr Virtual Bus host address"
	default "127.0.0.1"

config ZVB_BUS_ZVB_HOST_PORT
	int "ZVB Zephyr Virtual Bus host port"
	default 5656

config ZVB_BUS_ZVB_THREAD_PRIORITY
	int "ZVB Zephyr Virtual Bus thread priority"
	default 10

config ZVB_BUS_ZVB_THREAD_STACK_SIZE
	int "ZVB Zephyr Virtual Bus thread stack size"
	default 4096

config ZVB_BUS_ZVB_INIT_PRIORITY
	int "ZVB Zephyr Virtual Bus initialization priority"
	default 50

endif # ZVB_BUS_ZVB
```

## dts/bindings/actuator/dfrobot,dri0042.yaml
```yaml
# Copyright (c) 2025 Nordic Semiconductor ASA
# SPDX-License-Identifier: Apache-2.0

description: |
  DFRobot DRI0042 15A single DC Motor Driver

  Control signal table:

    IN1 IN2
    0   0   Stop
    1   1
    1   0   Forward
    0   1   Backward

  Minimum pulse width: 200 ns

include:
  - actuator-device.yaml

compatible: dfrobot,dri0042

properties:
  pwms:
    type: phandle-array
    required: true
    description: PWM Speed control signal

  in1-gpios:
    type: phandle-array
    required: true
    description: IN1 Motor steering control signal 1

  in2-gpios:
    type: phandle-array
    required: true
    description: IN2 Motor steering control signal 2
```

## dts/bindings/actuator/zvb,actuator.yaml
```yaml
# Copyright (c) 2025 Nordic Semiconductor ASA
# SPDX-License-Identifier: Apache-2.0

description: |
  Zephyr Virtual Board actuator

  Example:

    zvb {
            compatible = "zvb,zvb-bus";

            actuator0: actuator@0 {
                    compatible = "zvb,actuator";
                    reg = <0>;
            };
    };

compatible: zvb,actuator

include:
  - zvb-bus-device.yaml
```

## dts/bindings/input/zvb,button.yaml
```yaml
# Copyright (c) 2025 Nordic Semiconductor ASA
# SPDX-License-Identifier: Apache-2.0

description: |
  Zephyr Virtual Board Button

  Example:

    zvb {
            compatible = "zvb,zvb-bus";

            button0: button@0 {
                    compatible = "zvb,button";
                    reg = <0>;
            };
    };

compatible: zvb,button

include:
  - zvb-bus-device.yaml

properties:
  zephyr,code:
    type: int
    description: Key code to emit.
    required: true
```

## dts/bindings/led/zvb,led.yaml
```yaml
# Copyright (c) 2025 Nordic Semiconductor ASA
# SPDX-License-Identifier: Apache-2.0

description: |
  Zephyr Virtual Board LED

  Example:

    zvb {
            compatible = "zvb,zvb-bus";

            led0: led@0 {
                    compatible = "zvb,led";
                    reg = <0>;
            };
    };

compatible: zvb,led

include:
  - zvb-bus-device.yaml
```

## dts/bindings/sensor/soft-qdec.yaml
```yaml
# Copyright (c) 2025 Nordic Semiconductor ASA
# SPDX-License-Identifier: Apache-2.0

description: |
  Software QDEC peripheral

  Example:

    / {

            qdec0: qdec0 {
                    compatible = "soft-qdec";
                    ipc = &ipc;
            };
    };

compatible: soft-qdec

include:
  - sensor-device.yaml

properties:
  ipc:
    type: phandle
    description: IPC instance
    required: true

  steps-per-rotation:
    type: int
    description: Steps per full rotation
    required: true
```

## dts/bindings/sensor/zvb,sensor.yaml
```yaml
# Copyright (c) 2025 Nordic Semiconductor ASA
# SPDX-License-Identifier: Apache-2.0

description: |
  Zephyr Virtual Board Sensor

  Example:

    zvb {
            compatible = "zvb,zvb-bus";

            sensor0: sensor@0 {
                    reg = <0>;
                    compatible = "zvb,sensor";
            };
    };

compatible: zvb,sensor

include:
  - sensor-device.yaml
  - zvb-bus-device.yaml
```
